/*
 * Copyright (c) 2024 The ZMK Contributors
 *
 * SPDX-License-Identifier: MIT
 */
 
#include <dt-bindings/zmk/matrix_transform.h>
#include <physical_layouts.dtsi>
#include "ballpadyl.dtsi"

&kscan0 {
    col-gpios
        = <&pro_micro 24 GPIO_ACTIVE_HIGH>
        , <&pro_micro 22 GPIO_ACTIVE_HIGH>
        , <&pro_micro 20 GPIO_ACTIVE_HIGH>
        , <&pro_micro 17 GPIO_ACTIVE_HIGH>
        , <&pro_micro 8 GPIO_ACTIVE_HIGH>
        , <&pro_micro 6 GPIO_ACTIVE_HIGH>
        ;
};
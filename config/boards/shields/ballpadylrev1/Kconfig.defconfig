## config/boards/shields/ballpadylrev1/Kconfig.defconfig
```kconfig
# Copyright (c) 2024 The ZMK Contributors
# SPDX-License-Identifier: MIT

if SHIELD_ballpadyl_LEFT

config ZMK_KEYBOARD_NAME
	default "ballpadyl"

config ZMK_SPLIT_BLE_ROLE_CENTRAL
	default y

endif

if SHIELD_ballpadyl_LEFT || SHIELD_ballpadyl_RIGHT

config ZMK_SPLIT
	default y

endif
```

## config/boards/shields/ballpadylrev1/Kconfig.shield
```kconfig
# Copyright (c) 2024 The ZMK Contributors
# SPDX-License-Identifier: MIT

config SHIELD_ballpadyl_LEFT
      def_bool $(shields_list_contains,ballpadyl_left)

config SHIELD_ballpadyl_RIGHT
      def_bool $(shields_list_contains,ballpadyl_right)
```
